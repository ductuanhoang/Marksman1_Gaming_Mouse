// Add your new core rgb matrix effect here, order determins enum order, requires "led_animations/ directory
#include "led_animations/solid_color_anim.h"
// #include "led_animations/alpha_mods_anim.h"
#include "led_animations/gradient_up_down_anim.h"
#include "led_animations/gradient_left_right_anim.h"
#include "led_animations/breathing_anim.h"
// #include "led_animations/colorband_sat_anim.h"
// #include "led_animations/colorband_val_anim.h"
// #include "led_animations/colorband_pinwheel_sat_anim.h"
// #include "led_animations/colorband_pinwheel_val_anim.h"
// #include "led_animations/colorband_spiral_sat_anim.h"
// #include "led_animations/colorband_spiral_val_anim.h"
// #include "led_animations/cycle_all_anim.h"
// #include "led_animations/cycle_left_right_anim.h"
// #include "led_animations/cycle_up_down_anim.h"
// #include "led_animations/rainbow_moving_chevron_anim.h"
// #include "led_animations/cycle_out_in_anim.h"
// #include "led_animations/cycle_out_in_dual_anim.h"
// #include "led_animations/cycle_pinwheel_anim.h"
// #include "led_animations/cycle_spiral_anim.h"
// #include "led_animations/dual_beacon_anim.h"
// #include "led_animations/rainbow_beacon_anim.h"
// #include "led_animations/rainbow_pinwheels_anim.h"
// #include "led_animations/raindrops_anim.h"
// #include "led_animations/jellybean_raindrops_anim.h"
// #include "led_animations/typing_heatmap_anim.h"
// #include "led_animations/digital_rain_anim.h"
// #include "led_animations/solid_reactive_simple_anim.h"
// #include "led_animations/solid_reactive_anim.h"
// #include "led_animations/solid_reactive_wide.h"
// #include "led_animations/solid_reactive_cross.h"
// #include "led_animations/solid_reactive_nexus.h"
// #include "led_animations/splash_anim.h"
// #include "led_animations/solid_splash_anim.h"
#include "led_animations/scanning_anim.h"
